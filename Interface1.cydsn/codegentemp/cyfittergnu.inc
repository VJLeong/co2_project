/*******************************************************************************
* File Name: cyfittergnu.inc
* 
* PSoC Creator  4.4
*
* Description:
* 
* This file is automatically generated by PSoC Creator.
*
********************************************************************************
* Copyright (c) 2007-2020 Cypress Semiconductor.  All rights reserved.
* You may use this file only in accordance with the license, terms, conditions, 
* disclaimers, and limitations in the end user license agreement accompanying 
* the software package with which this file was provided.
********************************************************************************/

.ifndef INCLUDED_CYFITTERGNU_INC
.set INCLUDED_CYFITTERGNU_INC, 1
.include "cydevicegnu.inc"
.include "cydevicegnu_trm.inc"

/* Rx_1 */
.set Rx_1__0__INTTYPE, CYREG_PICU12_INTTYPE6
.set Rx_1__0__MASK, 0x40
.set Rx_1__0__PC, CYREG_PRT12_PC6
.set Rx_1__0__PORT, 12
.set Rx_1__0__SHIFT, 6
.set Rx_1__AG, CYREG_PRT12_AG
.set Rx_1__BIE, CYREG_PRT12_BIE
.set Rx_1__BIT_MASK, CYREG_PRT12_BIT_MASK
.set Rx_1__BYP, CYREG_PRT12_BYP
.set Rx_1__DM0, CYREG_PRT12_DM0
.set Rx_1__DM1, CYREG_PRT12_DM1
.set Rx_1__DM2, CYREG_PRT12_DM2
.set Rx_1__DR, CYREG_PRT12_DR
.set Rx_1__INP_DIS, CYREG_PRT12_INP_DIS
.set Rx_1__INTTYPE_BASE, CYDEV_PICU_INTTYPE_PICU12_BASE
.set Rx_1__MASK, 0x40
.set Rx_1__PORT, 12
.set Rx_1__PRT, CYREG_PRT12_PRT
.set Rx_1__PRTDSI__DBL_SYNC_IN, CYREG_PRT12_DBL_SYNC_IN
.set Rx_1__PRTDSI__OE_SEL0, CYREG_PRT12_OE_SEL0
.set Rx_1__PRTDSI__OE_SEL1, CYREG_PRT12_OE_SEL1
.set Rx_1__PRTDSI__OUT_SEL0, CYREG_PRT12_OUT_SEL0
.set Rx_1__PRTDSI__OUT_SEL1, CYREG_PRT12_OUT_SEL1
.set Rx_1__PRTDSI__SYNC_OUT, CYREG_PRT12_SYNC_OUT
.set Rx_1__PS, CYREG_PRT12_PS
.set Rx_1__SHIFT, 6
.set Rx_1__SIO_CFG, CYREG_PRT12_SIO_CFG
.set Rx_1__SIO_DIFF, CYREG_PRT12_SIO_DIFF
.set Rx_1__SIO_HYST_EN, CYREG_PRT12_SIO_HYST_EN
.set Rx_1__SIO_REG_HIFREQ, CYREG_PRT12_SIO_REG_HIFREQ
.set Rx_1__SLW, CYREG_PRT12_SLW

/* Tx_1 */
.set Tx_1__0__INTTYPE, CYREG_PICU12_INTTYPE7
.set Tx_1__0__MASK, 0x80
.set Tx_1__0__PC, CYREG_PRT12_PC7
.set Tx_1__0__PORT, 12
.set Tx_1__0__SHIFT, 7
.set Tx_1__AG, CYREG_PRT12_AG
.set Tx_1__BIE, CYREG_PRT12_BIE
.set Tx_1__BIT_MASK, CYREG_PRT12_BIT_MASK
.set Tx_1__BYP, CYREG_PRT12_BYP
.set Tx_1__DM0, CYREG_PRT12_DM0
.set Tx_1__DM1, CYREG_PRT12_DM1
.set Tx_1__DM2, CYREG_PRT12_DM2
.set Tx_1__DR, CYREG_PRT12_DR
.set Tx_1__INP_DIS, CYREG_PRT12_INP_DIS
.set Tx_1__INTTYPE_BASE, CYDEV_PICU_INTTYPE_PICU12_BASE
.set Tx_1__MASK, 0x80
.set Tx_1__PORT, 12
.set Tx_1__PRT, CYREG_PRT12_PRT
.set Tx_1__PRTDSI__DBL_SYNC_IN, CYREG_PRT12_DBL_SYNC_IN
.set Tx_1__PRTDSI__OE_SEL0, CYREG_PRT12_OE_SEL0
.set Tx_1__PRTDSI__OE_SEL1, CYREG_PRT12_OE_SEL1
.set Tx_1__PRTDSI__OUT_SEL0, CYREG_PRT12_OUT_SEL0
.set Tx_1__PRTDSI__OUT_SEL1, CYREG_PRT12_OUT_SEL1
.set Tx_1__PRTDSI__SYNC_OUT, CYREG_PRT12_SYNC_OUT
.set Tx_1__PS, CYREG_PRT12_PS
.set Tx_1__SHIFT, 7
.set Tx_1__SIO_CFG, CYREG_PRT12_SIO_CFG
.set Tx_1__SIO_DIFF, CYREG_PRT12_SIO_DIFF
.set Tx_1__SIO_HYST_EN, CYREG_PRT12_SIO_HYST_EN
.set Tx_1__SIO_REG_HIFREQ, CYREG_PRT12_SIO_REG_HIFREQ
.set Tx_1__SLW, CYREG_PRT12_SLW

/* I2C_1 */
.set I2C_1_I2C_FF__ADR, CYREG_I2C_ADR
.set I2C_1_I2C_FF__CFG, CYREG_I2C_CFG
.set I2C_1_I2C_FF__CLK_DIV1, CYREG_I2C_CLK_DIV1
.set I2C_1_I2C_FF__CLK_DIV2, CYREG_I2C_CLK_DIV2
.set I2C_1_I2C_FF__CSR, CYREG_I2C_CSR
.set I2C_1_I2C_FF__D, CYREG_I2C_D
.set I2C_1_I2C_FF__MCSR, CYREG_I2C_MCSR
.set I2C_1_I2C_FF__PM_ACT_CFG, CYREG_PM_ACT_CFG5
.set I2C_1_I2C_FF__PM_ACT_MSK, 0x04
.set I2C_1_I2C_FF__PM_STBY_CFG, CYREG_PM_STBY_CFG5
.set I2C_1_I2C_FF__PM_STBY_MSK, 0x04
.set I2C_1_I2C_FF__TMOUT_CFG0, CYREG_I2C_TMOUT_CFG0
.set I2C_1_I2C_FF__TMOUT_CFG1, CYREG_I2C_TMOUT_CFG1
.set I2C_1_I2C_FF__TMOUT_CSR, CYREG_I2C_TMOUT_CSR
.set I2C_1_I2C_FF__TMOUT_SR, CYREG_I2C_TMOUT_SR
.set I2C_1_I2C_FF__XCFG, CYREG_I2C_XCFG
.set I2C_1_I2C_IRQ__INTC_CLR_EN_REG, CYREG_NVIC_CLRENA0
.set I2C_1_I2C_IRQ__INTC_CLR_PD_REG, CYREG_NVIC_CLRPEND0
.set I2C_1_I2C_IRQ__INTC_MASK, 0x8000
.set I2C_1_I2C_IRQ__INTC_NUMBER, 15
.set I2C_1_I2C_IRQ__INTC_PRIOR_NUM, 7
.set I2C_1_I2C_IRQ__INTC_PRIOR_REG, CYREG_NVIC_PRI_15
.set I2C_1_I2C_IRQ__INTC_SET_EN_REG, CYREG_NVIC_SETENA0
.set I2C_1_I2C_IRQ__INTC_SET_PD_REG, CYREG_NVIC_SETPEND0

/* SCL_1 */
.set SCL_1__0__INTTYPE, CYREG_PICU12_INTTYPE0
.set SCL_1__0__MASK, 0x01
.set SCL_1__0__PC, CYREG_PRT12_PC0
.set SCL_1__0__PORT, 12
.set SCL_1__0__SHIFT, 0
.set SCL_1__AG, CYREG_PRT12_AG
.set SCL_1__BIE, CYREG_PRT12_BIE
.set SCL_1__BIT_MASK, CYREG_PRT12_BIT_MASK
.set SCL_1__BYP, CYREG_PRT12_BYP
.set SCL_1__DM0, CYREG_PRT12_DM0
.set SCL_1__DM1, CYREG_PRT12_DM1
.set SCL_1__DM2, CYREG_PRT12_DM2
.set SCL_1__DR, CYREG_PRT12_DR
.set SCL_1__INP_DIS, CYREG_PRT12_INP_DIS
.set SCL_1__INTTYPE_BASE, CYDEV_PICU_INTTYPE_PICU12_BASE
.set SCL_1__MASK, 0x01
.set SCL_1__PORT, 12
.set SCL_1__PRT, CYREG_PRT12_PRT
.set SCL_1__PRTDSI__DBL_SYNC_IN, CYREG_PRT12_DBL_SYNC_IN
.set SCL_1__PRTDSI__OE_SEL0, CYREG_PRT12_OE_SEL0
.set SCL_1__PRTDSI__OE_SEL1, CYREG_PRT12_OE_SEL1
.set SCL_1__PRTDSI__OUT_SEL0, CYREG_PRT12_OUT_SEL0
.set SCL_1__PRTDSI__OUT_SEL1, CYREG_PRT12_OUT_SEL1
.set SCL_1__PRTDSI__SYNC_OUT, CYREG_PRT12_SYNC_OUT
.set SCL_1__PS, CYREG_PRT12_PS
.set SCL_1__SHIFT, 0
.set SCL_1__SIO_CFG, CYREG_PRT12_SIO_CFG
.set SCL_1__SIO_DIFF, CYREG_PRT12_SIO_DIFF
.set SCL_1__SIO_HYST_EN, CYREG_PRT12_SIO_HYST_EN
.set SCL_1__SIO_REG_HIFREQ, CYREG_PRT12_SIO_REG_HIFREQ
.set SCL_1__SLW, CYREG_PRT12_SLW

/* SDA_1 */
.set SDA_1__0__INTTYPE, CYREG_PICU12_INTTYPE1
.set SDA_1__0__MASK, 0x02
.set SDA_1__0__PC, CYREG_PRT12_PC1
.set SDA_1__0__PORT, 12
.set SDA_1__0__SHIFT, 1
.set SDA_1__AG, CYREG_PRT12_AG
.set SDA_1__BIE, CYREG_PRT12_BIE
.set SDA_1__BIT_MASK, CYREG_PRT12_BIT_MASK
.set SDA_1__BYP, CYREG_PRT12_BYP
.set SDA_1__DM0, CYREG_PRT12_DM0
.set SDA_1__DM1, CYREG_PRT12_DM1
.set SDA_1__DM2, CYREG_PRT12_DM2
.set SDA_1__DR, CYREG_PRT12_DR
.set SDA_1__INP_DIS, CYREG_PRT12_INP_DIS
.set SDA_1__INTTYPE_BASE, CYDEV_PICU_INTTYPE_PICU12_BASE
.set SDA_1__MASK, 0x02
.set SDA_1__PORT, 12
.set SDA_1__PRT, CYREG_PRT12_PRT
.set SDA_1__PRTDSI__DBL_SYNC_IN, CYREG_PRT12_DBL_SYNC_IN
.set SDA_1__PRTDSI__OE_SEL0, CYREG_PRT12_OE_SEL0
.set SDA_1__PRTDSI__OE_SEL1, CYREG_PRT12_OE_SEL1
.set SDA_1__PRTDSI__OUT_SEL0, CYREG_PRT12_OUT_SEL0
.set SDA_1__PRTDSI__OUT_SEL1, CYREG_PRT12_OUT_SEL1
.set SDA_1__PRTDSI__SYNC_OUT, CYREG_PRT12_SYNC_OUT
.set SDA_1__PS, CYREG_PRT12_PS
.set SDA_1__SHIFT, 1
.set SDA_1__SIO_CFG, CYREG_PRT12_SIO_CFG
.set SDA_1__SIO_DIFF, CYREG_PRT12_SIO_DIFF
.set SDA_1__SIO_HYST_EN, CYREG_PRT12_SIO_HYST_EN
.set SDA_1__SIO_REG_HIFREQ, CYREG_PRT12_SIO_REG_HIFREQ
.set SDA_1__SLW, CYREG_PRT12_SLW

/* UART_1 */
.set UART_1_BUART_sRX_RxBitCounter__16BIT_CONTROL_AUX_CTL_REG, CYREG_B1_UDB09_10_ACTL
.set UART_1_BUART_sRX_RxBitCounter__16BIT_CONTROL_CONTROL_REG, CYREG_B1_UDB09_10_CTL
.set UART_1_BUART_sRX_RxBitCounter__16BIT_CONTROL_COUNT_REG, CYREG_B1_UDB09_10_CTL
.set UART_1_BUART_sRX_RxBitCounter__16BIT_COUNT_CONTROL_REG, CYREG_B1_UDB09_10_CTL
.set UART_1_BUART_sRX_RxBitCounter__16BIT_COUNT_COUNT_REG, CYREG_B1_UDB09_10_CTL
.set UART_1_BUART_sRX_RxBitCounter__16BIT_MASK_MASK_REG, CYREG_B1_UDB09_10_MSK
.set UART_1_BUART_sRX_RxBitCounter__16BIT_MASK_PERIOD_REG, CYREG_B1_UDB09_10_MSK
.set UART_1_BUART_sRX_RxBitCounter__16BIT_PERIOD_MASK_REG, CYREG_B1_UDB09_10_MSK
.set UART_1_BUART_sRX_RxBitCounter__16BIT_PERIOD_PERIOD_REG, CYREG_B1_UDB09_10_MSK
.set UART_1_BUART_sRX_RxBitCounter__CONTROL_AUX_CTL_REG, CYREG_B1_UDB09_ACTL
.set UART_1_BUART_sRX_RxBitCounter__CONTROL_REG, CYREG_B1_UDB09_CTL
.set UART_1_BUART_sRX_RxBitCounter__CONTROL_ST_REG, CYREG_B1_UDB09_ST_CTL
.set UART_1_BUART_sRX_RxBitCounter__COUNT_REG, CYREG_B1_UDB09_CTL
.set UART_1_BUART_sRX_RxBitCounter__COUNT_ST_REG, CYREG_B1_UDB09_ST_CTL
.set UART_1_BUART_sRX_RxBitCounter__MASK_CTL_AUX_CTL_REG, CYREG_B1_UDB09_MSK_ACTL
.set UART_1_BUART_sRX_RxBitCounter__PER_CTL_AUX_CTL_REG, CYREG_B1_UDB09_MSK_ACTL
.set UART_1_BUART_sRX_RxBitCounter__PERIOD_REG, CYREG_B1_UDB09_MSK
.set UART_1_BUART_sRX_RxBitCounter_ST__16BIT_STATUS_AUX_CTL_REG, CYREG_B1_UDB09_10_ACTL
.set UART_1_BUART_sRX_RxBitCounter_ST__16BIT_STATUS_REG, CYREG_B1_UDB09_10_ST
.set UART_1_BUART_sRX_RxBitCounter_ST__MASK_REG, CYREG_B1_UDB09_MSK
.set UART_1_BUART_sRX_RxBitCounter_ST__MASK_ST_AUX_CTL_REG, CYREG_B1_UDB09_MSK_ACTL
.set UART_1_BUART_sRX_RxBitCounter_ST__PER_ST_AUX_CTL_REG, CYREG_B1_UDB09_MSK_ACTL
.set UART_1_BUART_sRX_RxBitCounter_ST__STATUS_AUX_CTL_REG, CYREG_B1_UDB09_ACTL
.set UART_1_BUART_sRX_RxBitCounter_ST__STATUS_CNT_REG, CYREG_B1_UDB09_ST_CTL
.set UART_1_BUART_sRX_RxBitCounter_ST__STATUS_CONTROL_REG, CYREG_B1_UDB09_ST_CTL
.set UART_1_BUART_sRX_RxBitCounter_ST__STATUS_REG, CYREG_B1_UDB09_ST
.set UART_1_BUART_sRX_RxShifter_u0__16BIT_A0_REG, CYREG_B1_UDB09_10_A0
.set UART_1_BUART_sRX_RxShifter_u0__16BIT_A1_REG, CYREG_B1_UDB09_10_A1
.set UART_1_BUART_sRX_RxShifter_u0__16BIT_D0_REG, CYREG_B1_UDB09_10_D0
.set UART_1_BUART_sRX_RxShifter_u0__16BIT_D1_REG, CYREG_B1_UDB09_10_D1
.set UART_1_BUART_sRX_RxShifter_u0__16BIT_DP_AUX_CTL_REG, CYREG_B1_UDB09_10_ACTL
.set UART_1_BUART_sRX_RxShifter_u0__16BIT_F0_REG, CYREG_B1_UDB09_10_F0
.set UART_1_BUART_sRX_RxShifter_u0__16BIT_F1_REG, CYREG_B1_UDB09_10_F1
.set UART_1_BUART_sRX_RxShifter_u0__A0_A1_REG, CYREG_B1_UDB09_A0_A1
.set UART_1_BUART_sRX_RxShifter_u0__A0_REG, CYREG_B1_UDB09_A0
.set UART_1_BUART_sRX_RxShifter_u0__A1_REG, CYREG_B1_UDB09_A1
.set UART_1_BUART_sRX_RxShifter_u0__D0_D1_REG, CYREG_B1_UDB09_D0_D1
.set UART_1_BUART_sRX_RxShifter_u0__D0_REG, CYREG_B1_UDB09_D0
.set UART_1_BUART_sRX_RxShifter_u0__D1_REG, CYREG_B1_UDB09_D1
.set UART_1_BUART_sRX_RxShifter_u0__DP_AUX_CTL_REG, CYREG_B1_UDB09_ACTL
.set UART_1_BUART_sRX_RxShifter_u0__F0_F1_REG, CYREG_B1_UDB09_F0_F1
.set UART_1_BUART_sRX_RxShifter_u0__F0_REG, CYREG_B1_UDB09_F0
.set UART_1_BUART_sRX_RxShifter_u0__F1_REG, CYREG_B1_UDB09_F1
.set UART_1_BUART_sRX_RxShifter_u0__MSK_DP_AUX_CTL_REG, CYREG_B1_UDB09_MSK_ACTL
.set UART_1_BUART_sRX_RxShifter_u0__PER_DP_AUX_CTL_REG, CYREG_B1_UDB09_MSK_ACTL
.set UART_1_BUART_sRX_RxSts__16BIT_STATUS_AUX_CTL_REG, CYREG_B1_UDB10_11_ACTL
.set UART_1_BUART_sRX_RxSts__16BIT_STATUS_REG, CYREG_B1_UDB10_11_ST
.set UART_1_BUART_sRX_RxSts__3__MASK, 0x08
.set UART_1_BUART_sRX_RxSts__3__POS, 3
.set UART_1_BUART_sRX_RxSts__4__MASK, 0x10
.set UART_1_BUART_sRX_RxSts__4__POS, 4
.set UART_1_BUART_sRX_RxSts__5__MASK, 0x20
.set UART_1_BUART_sRX_RxSts__5__POS, 5
.set UART_1_BUART_sRX_RxSts__MASK, 0x38
.set UART_1_BUART_sRX_RxSts__MASK_REG, CYREG_B1_UDB10_MSK
.set UART_1_BUART_sRX_RxSts__STATUS_AUX_CTL_REG, CYREG_B1_UDB10_ACTL
.set UART_1_BUART_sRX_RxSts__STATUS_REG, CYREG_B1_UDB10_ST
.set UART_1_BUART_sTX_sCLOCK_TxBitClkGen__16BIT_A0_REG, CYREG_B1_UDB08_09_A0
.set UART_1_BUART_sTX_sCLOCK_TxBitClkGen__16BIT_A1_REG, CYREG_B1_UDB08_09_A1
.set UART_1_BUART_sTX_sCLOCK_TxBitClkGen__16BIT_D0_REG, CYREG_B1_UDB08_09_D0
.set UART_1_BUART_sTX_sCLOCK_TxBitClkGen__16BIT_D1_REG, CYREG_B1_UDB08_09_D1
.set UART_1_BUART_sTX_sCLOCK_TxBitClkGen__16BIT_DP_AUX_CTL_REG, CYREG_B1_UDB08_09_ACTL
.set UART_1_BUART_sTX_sCLOCK_TxBitClkGen__16BIT_F0_REG, CYREG_B1_UDB08_09_F0
.set UART_1_BUART_sTX_sCLOCK_TxBitClkGen__16BIT_F1_REG, CYREG_B1_UDB08_09_F1
.set UART_1_BUART_sTX_sCLOCK_TxBitClkGen__A0_A1_REG, CYREG_B1_UDB08_A0_A1
.set UART_1_BUART_sTX_sCLOCK_TxBitClkGen__A0_REG, CYREG_B1_UDB08_A0
.set UART_1_BUART_sTX_sCLOCK_TxBitClkGen__A1_REG, CYREG_B1_UDB08_A1
.set UART_1_BUART_sTX_sCLOCK_TxBitClkGen__D0_D1_REG, CYREG_B1_UDB08_D0_D1
.set UART_1_BUART_sTX_sCLOCK_TxBitClkGen__D0_REG, CYREG_B1_UDB08_D0
.set UART_1_BUART_sTX_sCLOCK_TxBitClkGen__D1_REG, CYREG_B1_UDB08_D1
.set UART_1_BUART_sTX_sCLOCK_TxBitClkGen__DP_AUX_CTL_REG, CYREG_B1_UDB08_ACTL
.set UART_1_BUART_sTX_sCLOCK_TxBitClkGen__F0_F1_REG, CYREG_B1_UDB08_F0_F1
.set UART_1_BUART_sTX_sCLOCK_TxBitClkGen__F0_REG, CYREG_B1_UDB08_F0
.set UART_1_BUART_sTX_sCLOCK_TxBitClkGen__F1_REG, CYREG_B1_UDB08_F1
.set UART_1_BUART_sTX_TxShifter_u0__16BIT_A0_REG, CYREG_B0_UDB13_14_A0
.set UART_1_BUART_sTX_TxShifter_u0__16BIT_A1_REG, CYREG_B0_UDB13_14_A1
.set UART_1_BUART_sTX_TxShifter_u0__16BIT_D0_REG, CYREG_B0_UDB13_14_D0
.set UART_1_BUART_sTX_TxShifter_u0__16BIT_D1_REG, CYREG_B0_UDB13_14_D1
.set UART_1_BUART_sTX_TxShifter_u0__16BIT_DP_AUX_CTL_REG, CYREG_B0_UDB13_14_ACTL
.set UART_1_BUART_sTX_TxShifter_u0__16BIT_F0_REG, CYREG_B0_UDB13_14_F0
.set UART_1_BUART_sTX_TxShifter_u0__16BIT_F1_REG, CYREG_B0_UDB13_14_F1
.set UART_1_BUART_sTX_TxShifter_u0__A0_A1_REG, CYREG_B0_UDB13_A0_A1
.set UART_1_BUART_sTX_TxShifter_u0__A0_REG, CYREG_B0_UDB13_A0
.set UART_1_BUART_sTX_TxShifter_u0__A1_REG, CYREG_B0_UDB13_A1
.set UART_1_BUART_sTX_TxShifter_u0__D0_D1_REG, CYREG_B0_UDB13_D0_D1
.set UART_1_BUART_sTX_TxShifter_u0__D0_REG, CYREG_B0_UDB13_D0
.set UART_1_BUART_sTX_TxShifter_u0__D1_REG, CYREG_B0_UDB13_D1
.set UART_1_BUART_sTX_TxShifter_u0__DP_AUX_CTL_REG, CYREG_B0_UDB13_ACTL
.set UART_1_BUART_sTX_TxShifter_u0__F0_F1_REG, CYREG_B0_UDB13_F0_F1
.set UART_1_BUART_sTX_TxShifter_u0__F0_REG, CYREG_B0_UDB13_F0
.set UART_1_BUART_sTX_TxShifter_u0__F1_REG, CYREG_B0_UDB13_F1
.set UART_1_BUART_sTX_TxSts__0__MASK, 0x01
.set UART_1_BUART_sTX_TxSts__0__POS, 0
.set UART_1_BUART_sTX_TxSts__1__MASK, 0x02
.set UART_1_BUART_sTX_TxSts__1__POS, 1
.set UART_1_BUART_sTX_TxSts__16BIT_STATUS_AUX_CTL_REG, CYREG_B0_UDB13_14_ACTL
.set UART_1_BUART_sTX_TxSts__16BIT_STATUS_REG, CYREG_B0_UDB13_14_ST
.set UART_1_BUART_sTX_TxSts__2__MASK, 0x04
.set UART_1_BUART_sTX_TxSts__2__POS, 2
.set UART_1_BUART_sTX_TxSts__3__MASK, 0x08
.set UART_1_BUART_sTX_TxSts__3__POS, 3
.set UART_1_BUART_sTX_TxSts__MASK, 0x0F
.set UART_1_BUART_sTX_TxSts__MASK_REG, CYREG_B0_UDB13_MSK
.set UART_1_BUART_sTX_TxSts__STATUS_AUX_CTL_REG, CYREG_B0_UDB13_ACTL
.set UART_1_BUART_sTX_TxSts__STATUS_REG, CYREG_B0_UDB13_ST
.set UART_1_IntClock__CFG0, CYREG_CLKDIST_DCFG2_CFG0
.set UART_1_IntClock__CFG1, CYREG_CLKDIST_DCFG2_CFG1
.set UART_1_IntClock__CFG2, CYREG_CLKDIST_DCFG2_CFG2
.set UART_1_IntClock__CFG2_SRC_SEL_MASK, 0x07
.set UART_1_IntClock__INDEX, 0x02
.set UART_1_IntClock__PM_ACT_CFG, CYREG_PM_ACT_CFG2
.set UART_1_IntClock__PM_ACT_MSK, 0x04
.set UART_1_IntClock__PM_STBY_CFG, CYREG_PM_STBY_CFG2
.set UART_1_IntClock__PM_STBY_MSK, 0x04

/* Clock_1 */
.set Clock_1__CFG0, CYREG_CLKDIST_DCFG1_CFG0
.set Clock_1__CFG1, CYREG_CLKDIST_DCFG1_CFG1
.set Clock_1__CFG2, CYREG_CLKDIST_DCFG1_CFG2
.set Clock_1__CFG2_SRC_SEL_MASK, 0x07
.set Clock_1__INDEX, 0x01
.set Clock_1__PM_ACT_CFG, CYREG_PM_ACT_CFG2
.set Clock_1__PM_ACT_MSK, 0x02
.set Clock_1__PM_STBY_CFG, CYREG_PM_STBY_CFG2
.set Clock_1__PM_STBY_MSK, 0x02

/* Clock_2 */
.set Clock_2__CFG0, CYREG_CLKDIST_DCFG0_CFG0
.set Clock_2__CFG1, CYREG_CLKDIST_DCFG0_CFG1
.set Clock_2__CFG2, CYREG_CLKDIST_DCFG0_CFG2
.set Clock_2__CFG2_SRC_SEL_MASK, 0x07
.set Clock_2__INDEX, 0x00
.set Clock_2__PM_ACT_CFG, CYREG_PM_ACT_CFG2
.set Clock_2__PM_ACT_MSK, 0x01
.set Clock_2__PM_STBY_CFG, CYREG_PM_STBY_CFG2
.set Clock_2__PM_STBY_MSK, 0x01

/* Timer_1 */
.set Timer_1_TimerHW__CAP0, CYREG_TMR0_CAP0
.set Timer_1_TimerHW__CAP1, CYREG_TMR0_CAP1
.set Timer_1_TimerHW__CFG0, CYREG_TMR0_CFG0
.set Timer_1_TimerHW__CFG1, CYREG_TMR0_CFG1
.set Timer_1_TimerHW__CFG2, CYREG_TMR0_CFG2
.set Timer_1_TimerHW__CNT_CMP0, CYREG_TMR0_CNT_CMP0
.set Timer_1_TimerHW__CNT_CMP1, CYREG_TMR0_CNT_CMP1
.set Timer_1_TimerHW__PER0, CYREG_TMR0_PER0
.set Timer_1_TimerHW__PER1, CYREG_TMR0_PER1
.set Timer_1_TimerHW__PM_ACT_CFG, CYREG_PM_ACT_CFG3
.set Timer_1_TimerHW__PM_ACT_MSK, 0x01
.set Timer_1_TimerHW__PM_STBY_CFG, CYREG_PM_STBY_CFG3
.set Timer_1_TimerHW__PM_STBY_MSK, 0x01
.set Timer_1_TimerHW__RT0, CYREG_TMR0_RT0
.set Timer_1_TimerHW__RT1, CYREG_TMR0_RT1
.set Timer_1_TimerHW__SR0, CYREG_TMR0_SR0

/* ADC_SAR_1 */
.set ADC_SAR_1_ADC_SAR__CLK, CYREG_SAR0_CLK
.set ADC_SAR_1_ADC_SAR__CSR0, CYREG_SAR0_CSR0
.set ADC_SAR_1_ADC_SAR__CSR1, CYREG_SAR0_CSR1
.set ADC_SAR_1_ADC_SAR__CSR2, CYREG_SAR0_CSR2
.set ADC_SAR_1_ADC_SAR__CSR3, CYREG_SAR0_CSR3
.set ADC_SAR_1_ADC_SAR__CSR4, CYREG_SAR0_CSR4
.set ADC_SAR_1_ADC_SAR__CSR5, CYREG_SAR0_CSR5
.set ADC_SAR_1_ADC_SAR__CSR6, CYREG_SAR0_CSR6
.set ADC_SAR_1_ADC_SAR__PM_ACT_CFG, CYREG_PM_ACT_CFG11
.set ADC_SAR_1_ADC_SAR__PM_ACT_MSK, 0x01
.set ADC_SAR_1_ADC_SAR__PM_STBY_CFG, CYREG_PM_STBY_CFG11
.set ADC_SAR_1_ADC_SAR__PM_STBY_MSK, 0x01
.set ADC_SAR_1_ADC_SAR__SW0, CYREG_SAR0_SW0
.set ADC_SAR_1_ADC_SAR__SW2, CYREG_SAR0_SW2
.set ADC_SAR_1_ADC_SAR__SW3, CYREG_SAR0_SW3
.set ADC_SAR_1_ADC_SAR__SW4, CYREG_SAR0_SW4
.set ADC_SAR_1_ADC_SAR__SW6, CYREG_SAR0_SW6
.set ADC_SAR_1_ADC_SAR__TR0, CYREG_SAR0_TR0
.set ADC_SAR_1_ADC_SAR__WRK0, CYREG_SAR0_WRK0
.set ADC_SAR_1_ADC_SAR__WRK1, CYREG_SAR0_WRK1
.set ADC_SAR_1_IRQ__INTC_CLR_EN_REG, CYREG_NVIC_CLRENA0
.set ADC_SAR_1_IRQ__INTC_CLR_PD_REG, CYREG_NVIC_CLRPEND0
.set ADC_SAR_1_IRQ__INTC_MASK, 0x01
.set ADC_SAR_1_IRQ__INTC_NUMBER, 0
.set ADC_SAR_1_IRQ__INTC_PRIOR_NUM, 7
.set ADC_SAR_1_IRQ__INTC_PRIOR_REG, CYREG_NVIC_PRI_0
.set ADC_SAR_1_IRQ__INTC_SET_EN_REG, CYREG_NVIC_SETENA0
.set ADC_SAR_1_IRQ__INTC_SET_PD_REG, CYREG_NVIC_SETPEND0
.set ADC_SAR_1_theACLK__CFG0, CYREG_CLKDIST_ACFG0_CFG0
.set ADC_SAR_1_theACLK__CFG1, CYREG_CLKDIST_ACFG0_CFG1
.set ADC_SAR_1_theACLK__CFG2, CYREG_CLKDIST_ACFG0_CFG2
.set ADC_SAR_1_theACLK__CFG2_SRC_SEL_MASK, 0x07
.set ADC_SAR_1_theACLK__CFG3, CYREG_CLKDIST_ACFG0_CFG3
.set ADC_SAR_1_theACLK__CFG3_PHASE_DLY_MASK, 0x0F
.set ADC_SAR_1_theACLK__INDEX, 0x00
.set ADC_SAR_1_theACLK__PM_ACT_CFG, CYREG_PM_ACT_CFG1
.set ADC_SAR_1_theACLK__PM_ACT_MSK, 0x01
.set ADC_SAR_1_theACLK__PM_STBY_CFG, CYREG_PM_STBY_CFG1
.set ADC_SAR_1_theACLK__PM_STBY_MSK, 0x01

/* Counter_1 */
.set Counter_1_CounterUDB_sC32_counterdp_u0__16BIT_A0_REG, CYREG_B0_UDB08_09_A0
.set Counter_1_CounterUDB_sC32_counterdp_u0__16BIT_A1_REG, CYREG_B0_UDB08_09_A1
.set Counter_1_CounterUDB_sC32_counterdp_u0__16BIT_D0_REG, CYREG_B0_UDB08_09_D0
.set Counter_1_CounterUDB_sC32_counterdp_u0__16BIT_D1_REG, CYREG_B0_UDB08_09_D1
.set Counter_1_CounterUDB_sC32_counterdp_u0__16BIT_DP_AUX_CTL_REG, CYREG_B0_UDB08_09_ACTL
.set Counter_1_CounterUDB_sC32_counterdp_u0__16BIT_F0_REG, CYREG_B0_UDB08_09_F0
.set Counter_1_CounterUDB_sC32_counterdp_u0__16BIT_F1_REG, CYREG_B0_UDB08_09_F1
.set Counter_1_CounterUDB_sC32_counterdp_u0__A0_A1_REG, CYREG_B0_UDB08_A0_A1
.set Counter_1_CounterUDB_sC32_counterdp_u0__A0_REG, CYREG_B0_UDB08_A0
.set Counter_1_CounterUDB_sC32_counterdp_u0__A1_REG, CYREG_B0_UDB08_A1
.set Counter_1_CounterUDB_sC32_counterdp_u0__D0_D1_REG, CYREG_B0_UDB08_D0_D1
.set Counter_1_CounterUDB_sC32_counterdp_u0__D0_REG, CYREG_B0_UDB08_D0
.set Counter_1_CounterUDB_sC32_counterdp_u0__D1_REG, CYREG_B0_UDB08_D1
.set Counter_1_CounterUDB_sC32_counterdp_u0__DP_AUX_CTL_REG, CYREG_B0_UDB08_ACTL
.set Counter_1_CounterUDB_sC32_counterdp_u0__F0_F1_REG, CYREG_B0_UDB08_F0_F1
.set Counter_1_CounterUDB_sC32_counterdp_u0__F0_REG, CYREG_B0_UDB08_F0
.set Counter_1_CounterUDB_sC32_counterdp_u0__F1_REG, CYREG_B0_UDB08_F1
.set Counter_1_CounterUDB_sC32_counterdp_u1__16BIT_A0_REG, CYREG_B0_UDB09_10_A0
.set Counter_1_CounterUDB_sC32_counterdp_u1__16BIT_A1_REG, CYREG_B0_UDB09_10_A1
.set Counter_1_CounterUDB_sC32_counterdp_u1__16BIT_D0_REG, CYREG_B0_UDB09_10_D0
.set Counter_1_CounterUDB_sC32_counterdp_u1__16BIT_D1_REG, CYREG_B0_UDB09_10_D1
.set Counter_1_CounterUDB_sC32_counterdp_u1__16BIT_DP_AUX_CTL_REG, CYREG_B0_UDB09_10_ACTL
.set Counter_1_CounterUDB_sC32_counterdp_u1__16BIT_F0_REG, CYREG_B0_UDB09_10_F0
.set Counter_1_CounterUDB_sC32_counterdp_u1__16BIT_F1_REG, CYREG_B0_UDB09_10_F1
.set Counter_1_CounterUDB_sC32_counterdp_u1__A0_A1_REG, CYREG_B0_UDB09_A0_A1
.set Counter_1_CounterUDB_sC32_counterdp_u1__A0_REG, CYREG_B0_UDB09_A0
.set Counter_1_CounterUDB_sC32_counterdp_u1__A1_REG, CYREG_B0_UDB09_A1
.set Counter_1_CounterUDB_sC32_counterdp_u1__D0_D1_REG, CYREG_B0_UDB09_D0_D1
.set Counter_1_CounterUDB_sC32_counterdp_u1__D0_REG, CYREG_B0_UDB09_D0
.set Counter_1_CounterUDB_sC32_counterdp_u1__D1_REG, CYREG_B0_UDB09_D1
.set Counter_1_CounterUDB_sC32_counterdp_u1__DP_AUX_CTL_REG, CYREG_B0_UDB09_ACTL
.set Counter_1_CounterUDB_sC32_counterdp_u1__F0_F1_REG, CYREG_B0_UDB09_F0_F1
.set Counter_1_CounterUDB_sC32_counterdp_u1__F0_REG, CYREG_B0_UDB09_F0
.set Counter_1_CounterUDB_sC32_counterdp_u1__F1_REG, CYREG_B0_UDB09_F1
.set Counter_1_CounterUDB_sC32_counterdp_u2__16BIT_A0_REG, CYREG_B0_UDB10_11_A0
.set Counter_1_CounterUDB_sC32_counterdp_u2__16BIT_A1_REG, CYREG_B0_UDB10_11_A1
.set Counter_1_CounterUDB_sC32_counterdp_u2__16BIT_D0_REG, CYREG_B0_UDB10_11_D0
.set Counter_1_CounterUDB_sC32_counterdp_u2__16BIT_D1_REG, CYREG_B0_UDB10_11_D1
.set Counter_1_CounterUDB_sC32_counterdp_u2__16BIT_DP_AUX_CTL_REG, CYREG_B0_UDB10_11_ACTL
.set Counter_1_CounterUDB_sC32_counterdp_u2__16BIT_F0_REG, CYREG_B0_UDB10_11_F0
.set Counter_1_CounterUDB_sC32_counterdp_u2__16BIT_F1_REG, CYREG_B0_UDB10_11_F1
.set Counter_1_CounterUDB_sC32_counterdp_u2__A0_A1_REG, CYREG_B0_UDB10_A0_A1
.set Counter_1_CounterUDB_sC32_counterdp_u2__A0_REG, CYREG_B0_UDB10_A0
.set Counter_1_CounterUDB_sC32_counterdp_u2__A1_REG, CYREG_B0_UDB10_A1
.set Counter_1_CounterUDB_sC32_counterdp_u2__D0_D1_REG, CYREG_B0_UDB10_D0_D1
.set Counter_1_CounterUDB_sC32_counterdp_u2__D0_REG, CYREG_B0_UDB10_D0
.set Counter_1_CounterUDB_sC32_counterdp_u2__D1_REG, CYREG_B0_UDB10_D1
.set Counter_1_CounterUDB_sC32_counterdp_u2__DP_AUX_CTL_REG, CYREG_B0_UDB10_ACTL
.set Counter_1_CounterUDB_sC32_counterdp_u2__F0_F1_REG, CYREG_B0_UDB10_F0_F1
.set Counter_1_CounterUDB_sC32_counterdp_u2__F0_REG, CYREG_B0_UDB10_F0
.set Counter_1_CounterUDB_sC32_counterdp_u2__F1_REG, CYREG_B0_UDB10_F1
.set Counter_1_CounterUDB_sC32_counterdp_u3__16BIT_A0_REG, CYREG_B0_UDB11_12_A0
.set Counter_1_CounterUDB_sC32_counterdp_u3__16BIT_A1_REG, CYREG_B0_UDB11_12_A1
.set Counter_1_CounterUDB_sC32_counterdp_u3__16BIT_D0_REG, CYREG_B0_UDB11_12_D0
.set Counter_1_CounterUDB_sC32_counterdp_u3__16BIT_D1_REG, CYREG_B0_UDB11_12_D1
.set Counter_1_CounterUDB_sC32_counterdp_u3__16BIT_DP_AUX_CTL_REG, CYREG_B0_UDB11_12_ACTL
.set Counter_1_CounterUDB_sC32_counterdp_u3__16BIT_F0_REG, CYREG_B0_UDB11_12_F0
.set Counter_1_CounterUDB_sC32_counterdp_u3__16BIT_F1_REG, CYREG_B0_UDB11_12_F1
.set Counter_1_CounterUDB_sC32_counterdp_u3__A0_A1_REG, CYREG_B0_UDB11_A0_A1
.set Counter_1_CounterUDB_sC32_counterdp_u3__A0_REG, CYREG_B0_UDB11_A0
.set Counter_1_CounterUDB_sC32_counterdp_u3__A1_REG, CYREG_B0_UDB11_A1
.set Counter_1_CounterUDB_sC32_counterdp_u3__D0_D1_REG, CYREG_B0_UDB11_D0_D1
.set Counter_1_CounterUDB_sC32_counterdp_u3__D0_REG, CYREG_B0_UDB11_D0
.set Counter_1_CounterUDB_sC32_counterdp_u3__D1_REG, CYREG_B0_UDB11_D1
.set Counter_1_CounterUDB_sC32_counterdp_u3__DP_AUX_CTL_REG, CYREG_B0_UDB11_ACTL
.set Counter_1_CounterUDB_sC32_counterdp_u3__F0_F1_REG, CYREG_B0_UDB11_F0_F1
.set Counter_1_CounterUDB_sC32_counterdp_u3__F0_REG, CYREG_B0_UDB11_F0
.set Counter_1_CounterUDB_sC32_counterdp_u3__F1_REG, CYREG_B0_UDB11_F1
.set Counter_1_CounterUDB_sC32_counterdp_u3__MSK_DP_AUX_CTL_REG, CYREG_B0_UDB11_MSK_ACTL
.set Counter_1_CounterUDB_sC32_counterdp_u3__PER_DP_AUX_CTL_REG, CYREG_B0_UDB11_MSK_ACTL
.set Counter_1_CounterUDB_sCTRLReg_ctrlreg__0__MASK, 0x01
.set Counter_1_CounterUDB_sCTRLReg_ctrlreg__0__POS, 0
.set Counter_1_CounterUDB_sCTRLReg_ctrlreg__1__MASK, 0x02
.set Counter_1_CounterUDB_sCTRLReg_ctrlreg__1__POS, 1
.set Counter_1_CounterUDB_sCTRLReg_ctrlreg__16BIT_CONTROL_AUX_CTL_REG, CYREG_B0_UDB11_12_ACTL
.set Counter_1_CounterUDB_sCTRLReg_ctrlreg__16BIT_CONTROL_CONTROL_REG, CYREG_B0_UDB11_12_CTL
.set Counter_1_CounterUDB_sCTRLReg_ctrlreg__16BIT_CONTROL_COUNT_REG, CYREG_B0_UDB11_12_CTL
.set Counter_1_CounterUDB_sCTRLReg_ctrlreg__16BIT_COUNT_CONTROL_REG, CYREG_B0_UDB11_12_CTL
.set Counter_1_CounterUDB_sCTRLReg_ctrlreg__16BIT_COUNT_COUNT_REG, CYREG_B0_UDB11_12_CTL
.set Counter_1_CounterUDB_sCTRLReg_ctrlreg__16BIT_MASK_MASK_REG, CYREG_B0_UDB11_12_MSK
.set Counter_1_CounterUDB_sCTRLReg_ctrlreg__16BIT_MASK_PERIOD_REG, CYREG_B0_UDB11_12_MSK
.set Counter_1_CounterUDB_sCTRLReg_ctrlreg__16BIT_PERIOD_MASK_REG, CYREG_B0_UDB11_12_MSK
.set Counter_1_CounterUDB_sCTRLReg_ctrlreg__16BIT_PERIOD_PERIOD_REG, CYREG_B0_UDB11_12_MSK
.set Counter_1_CounterUDB_sCTRLReg_ctrlreg__2__MASK, 0x04
.set Counter_1_CounterUDB_sCTRLReg_ctrlreg__2__POS, 2
.set Counter_1_CounterUDB_sCTRLReg_ctrlreg__7__MASK, 0x80
.set Counter_1_CounterUDB_sCTRLReg_ctrlreg__7__POS, 7
.set Counter_1_CounterUDB_sCTRLReg_ctrlreg__CONTROL_AUX_CTL_REG, CYREG_B0_UDB11_ACTL
.set Counter_1_CounterUDB_sCTRLReg_ctrlreg__CONTROL_REG, CYREG_B0_UDB11_CTL
.set Counter_1_CounterUDB_sCTRLReg_ctrlreg__CONTROL_ST_REG, CYREG_B0_UDB11_ST_CTL
.set Counter_1_CounterUDB_sCTRLReg_ctrlreg__COUNT_REG, CYREG_B0_UDB11_CTL
.set Counter_1_CounterUDB_sCTRLReg_ctrlreg__COUNT_ST_REG, CYREG_B0_UDB11_ST_CTL
.set Counter_1_CounterUDB_sCTRLReg_ctrlreg__MASK, 0x87
.set Counter_1_CounterUDB_sCTRLReg_ctrlreg__MASK_CTL_AUX_CTL_REG, CYREG_B0_UDB11_MSK_ACTL
.set Counter_1_CounterUDB_sCTRLReg_ctrlreg__PER_CTL_AUX_CTL_REG, CYREG_B0_UDB11_MSK_ACTL
.set Counter_1_CounterUDB_sCTRLReg_ctrlreg__PERIOD_REG, CYREG_B0_UDB11_MSK
.set Counter_1_CounterUDB_sSTSReg_stsreg__0__MASK, 0x01
.set Counter_1_CounterUDB_sSTSReg_stsreg__0__POS, 0
.set Counter_1_CounterUDB_sSTSReg_stsreg__1__MASK, 0x02
.set Counter_1_CounterUDB_sSTSReg_stsreg__1__POS, 1
.set Counter_1_CounterUDB_sSTSReg_stsreg__16BIT_STATUS_AUX_CTL_REG, CYREG_B0_UDB11_12_ACTL
.set Counter_1_CounterUDB_sSTSReg_stsreg__16BIT_STATUS_REG, CYREG_B0_UDB11_12_ST
.set Counter_1_CounterUDB_sSTSReg_stsreg__2__MASK, 0x04
.set Counter_1_CounterUDB_sSTSReg_stsreg__2__POS, 2
.set Counter_1_CounterUDB_sSTSReg_stsreg__5__MASK, 0x20
.set Counter_1_CounterUDB_sSTSReg_stsreg__5__POS, 5
.set Counter_1_CounterUDB_sSTSReg_stsreg__6__MASK, 0x40
.set Counter_1_CounterUDB_sSTSReg_stsreg__6__POS, 6
.set Counter_1_CounterUDB_sSTSReg_stsreg__MASK, 0x67
.set Counter_1_CounterUDB_sSTSReg_stsreg__MASK_REG, CYREG_B0_UDB11_MSK
.set Counter_1_CounterUDB_sSTSReg_stsreg__MASK_ST_AUX_CTL_REG, CYREG_B0_UDB11_MSK_ACTL
.set Counter_1_CounterUDB_sSTSReg_stsreg__PER_ST_AUX_CTL_REG, CYREG_B0_UDB11_MSK_ACTL
.set Counter_1_CounterUDB_sSTSReg_stsreg__STATUS_AUX_CTL_REG, CYREG_B0_UDB11_ACTL
.set Counter_1_CounterUDB_sSTSReg_stsreg__STATUS_CNT_REG, CYREG_B0_UDB11_ST_CTL
.set Counter_1_CounterUDB_sSTSReg_stsreg__STATUS_CONTROL_REG, CYREG_B0_UDB11_ST_CTL
.set Counter_1_CounterUDB_sSTSReg_stsreg__STATUS_REG, CYREG_B0_UDB11_ST

/* Capacitance */
.set Capacitance__0__INTTYPE, CYREG_PICU0_INTTYPE1
.set Capacitance__0__MASK, 0x02
.set Capacitance__0__PC, CYREG_PRT0_PC1
.set Capacitance__0__PORT, 0
.set Capacitance__0__SHIFT, 1
.set Capacitance__AG, CYREG_PRT0_AG
.set Capacitance__AMUX, CYREG_PRT0_AMUX
.set Capacitance__BIE, CYREG_PRT0_BIE
.set Capacitance__BIT_MASK, CYREG_PRT0_BIT_MASK
.set Capacitance__BYP, CYREG_PRT0_BYP
.set Capacitance__CTL, CYREG_PRT0_CTL
.set Capacitance__DM0, CYREG_PRT0_DM0
.set Capacitance__DM1, CYREG_PRT0_DM1
.set Capacitance__DM2, CYREG_PRT0_DM2
.set Capacitance__DR, CYREG_PRT0_DR
.set Capacitance__INP_DIS, CYREG_PRT0_INP_DIS
.set Capacitance__INTTYPE_BASE, CYDEV_PICU_INTTYPE_PICU0_BASE
.set Capacitance__LCD_COM_SEG, CYREG_PRT0_LCD_COM_SEG
.set Capacitance__LCD_EN, CYREG_PRT0_LCD_EN
.set Capacitance__MASK, 0x02
.set Capacitance__PORT, 0
.set Capacitance__PRT, CYREG_PRT0_PRT
.set Capacitance__PRTDSI__CAPS_SEL, CYREG_PRT0_CAPS_SEL
.set Capacitance__PRTDSI__DBL_SYNC_IN, CYREG_PRT0_DBL_SYNC_IN
.set Capacitance__PRTDSI__OE_SEL0, CYREG_PRT0_OE_SEL0
.set Capacitance__PRTDSI__OE_SEL1, CYREG_PRT0_OE_SEL1
.set Capacitance__PRTDSI__OUT_SEL0, CYREG_PRT0_OUT_SEL0
.set Capacitance__PRTDSI__OUT_SEL1, CYREG_PRT0_OUT_SEL1
.set Capacitance__PRTDSI__SYNC_OUT, CYREG_PRT0_SYNC_OUT
.set Capacitance__PS, CYREG_PRT0_PS
.set Capacitance__SHIFT, 1
.set Capacitance__SLW, CYREG_PRT0_SLW

/* ChargingPin */
.set ChargingPin__0__INTTYPE, CYREG_PICU2_INTTYPE3
.set ChargingPin__0__MASK, 0x08
.set ChargingPin__0__PC, CYREG_PRT2_PC3
.set ChargingPin__0__PORT, 2
.set ChargingPin__0__SHIFT, 3
.set ChargingPin__AG, CYREG_PRT2_AG
.set ChargingPin__AMUX, CYREG_PRT2_AMUX
.set ChargingPin__BIE, CYREG_PRT2_BIE
.set ChargingPin__BIT_MASK, CYREG_PRT2_BIT_MASK
.set ChargingPin__BYP, CYREG_PRT2_BYP
.set ChargingPin__CTL, CYREG_PRT2_CTL
.set ChargingPin__DM0, CYREG_PRT2_DM0
.set ChargingPin__DM1, CYREG_PRT2_DM1
.set ChargingPin__DM2, CYREG_PRT2_DM2
.set ChargingPin__DR, CYREG_PRT2_DR
.set ChargingPin__INP_DIS, CYREG_PRT2_INP_DIS
.set ChargingPin__INTTYPE_BASE, CYDEV_PICU_INTTYPE_PICU2_BASE
.set ChargingPin__LCD_COM_SEG, CYREG_PRT2_LCD_COM_SEG
.set ChargingPin__LCD_EN, CYREG_PRT2_LCD_EN
.set ChargingPin__MASK, 0x08
.set ChargingPin__PORT, 2
.set ChargingPin__PRT, CYREG_PRT2_PRT
.set ChargingPin__PRTDSI__CAPS_SEL, CYREG_PRT2_CAPS_SEL
.set ChargingPin__PRTDSI__DBL_SYNC_IN, CYREG_PRT2_DBL_SYNC_IN
.set ChargingPin__PRTDSI__OE_SEL0, CYREG_PRT2_OE_SEL0
.set ChargingPin__PRTDSI__OE_SEL1, CYREG_PRT2_OE_SEL1
.set ChargingPin__PRTDSI__OUT_SEL0, CYREG_PRT2_OUT_SEL0
.set ChargingPin__PRTDSI__OUT_SEL1, CYREG_PRT2_OUT_SEL1
.set ChargingPin__PRTDSI__SYNC_OUT, CYREG_PRT2_SYNC_OUT
.set ChargingPin__PS, CYREG_PRT2_PS
.set ChargingPin__SHIFT, 3
.set ChargingPin__SLW, CYREG_PRT2_SLW

/* TimerOutput */
.set TimerOutput__0__INTTYPE, CYREG_PICU2_INTTYPE5
.set TimerOutput__0__MASK, 0x20
.set TimerOutput__0__PC, CYREG_PRT2_PC5
.set TimerOutput__0__PORT, 2
.set TimerOutput__0__SHIFT, 5
.set TimerOutput__AG, CYREG_PRT2_AG
.set TimerOutput__AMUX, CYREG_PRT2_AMUX
.set TimerOutput__BIE, CYREG_PRT2_BIE
.set TimerOutput__BIT_MASK, CYREG_PRT2_BIT_MASK
.set TimerOutput__BYP, CYREG_PRT2_BYP
.set TimerOutput__CTL, CYREG_PRT2_CTL
.set TimerOutput__DM0, CYREG_PRT2_DM0
.set TimerOutput__DM1, CYREG_PRT2_DM1
.set TimerOutput__DM2, CYREG_PRT2_DM2
.set TimerOutput__DR, CYREG_PRT2_DR
.set TimerOutput__INP_DIS, CYREG_PRT2_INP_DIS
.set TimerOutput__INTTYPE_BASE, CYDEV_PICU_INTTYPE_PICU2_BASE
.set TimerOutput__LCD_COM_SEG, CYREG_PRT2_LCD_COM_SEG
.set TimerOutput__LCD_EN, CYREG_PRT2_LCD_EN
.set TimerOutput__MASK, 0x20
.set TimerOutput__PORT, 2
.set TimerOutput__PRT, CYREG_PRT2_PRT
.set TimerOutput__PRTDSI__CAPS_SEL, CYREG_PRT2_CAPS_SEL
.set TimerOutput__PRTDSI__DBL_SYNC_IN, CYREG_PRT2_DBL_SYNC_IN
.set TimerOutput__PRTDSI__OE_SEL0, CYREG_PRT2_OE_SEL0
.set TimerOutput__PRTDSI__OE_SEL1, CYREG_PRT2_OE_SEL1
.set TimerOutput__PRTDSI__OUT_SEL0, CYREG_PRT2_OUT_SEL0
.set TimerOutput__PRTDSI__OUT_SEL1, CYREG_PRT2_OUT_SEL1
.set TimerOutput__PRTDSI__SYNC_OUT, CYREG_PRT2_SYNC_OUT
.set TimerOutput__PS, CYREG_PRT2_PS
.set TimerOutput__SHIFT, 5
.set TimerOutput__SLW, CYREG_PRT2_SLW

/* Miscellaneous */
.set BCLK__BUS_CLK__HZ, 24000000
.set BCLK__BUS_CLK__KHZ, 24000
.set BCLK__BUS_CLK__MHZ, 24
.set CYDEV_CHIP_DIE_LEOPARD, 1
.set CYDEV_CHIP_DIE_PSOC4A, 26
.set CYDEV_CHIP_DIE_PSOC5LP, 2
.set CYDEV_CHIP_DIE_PSOC5TM, 3
.set CYDEV_CHIP_DIE_TMA4, 4
.set CYDEV_CHIP_DIE_UNKNOWN, 0
.set CYDEV_CHIP_FAMILY_FM0P, 5
.set CYDEV_CHIP_FAMILY_FM3, 6
.set CYDEV_CHIP_FAMILY_FM4, 7
.set CYDEV_CHIP_FAMILY_PSOC3, 1
.set CYDEV_CHIP_FAMILY_PSOC4, 2
.set CYDEV_CHIP_FAMILY_PSOC5, 3
.set CYDEV_CHIP_FAMILY_PSOC6, 4
.set CYDEV_CHIP_FAMILY_UNKNOWN, 0
.set CYDEV_CHIP_FAMILY_USED, CYDEV_CHIP_FAMILY_PSOC5
.set CYDEV_CHIP_JTAG_ID, 0x2E161069
.set CYDEV_CHIP_MEMBER_3A, 1
.set CYDEV_CHIP_MEMBER_4A, 26
.set CYDEV_CHIP_MEMBER_4AA, 25
.set CYDEV_CHIP_MEMBER_4AB, 30
.set CYDEV_CHIP_MEMBER_4AC, 14
.set CYDEV_CHIP_MEMBER_4AD, 15
.set CYDEV_CHIP_MEMBER_4AE, 16
.set CYDEV_CHIP_MEMBER_4D, 20
.set CYDEV_CHIP_MEMBER_4E, 6
.set CYDEV_CHIP_MEMBER_4F, 27
.set CYDEV_CHIP_MEMBER_4G, 4
.set CYDEV_CHIP_MEMBER_4H, 24
.set CYDEV_CHIP_MEMBER_4I, 32
.set CYDEV_CHIP_MEMBER_4J, 21
.set CYDEV_CHIP_MEMBER_4K, 22
.set CYDEV_CHIP_MEMBER_4L, 31
.set CYDEV_CHIP_MEMBER_4M, 29
.set CYDEV_CHIP_MEMBER_4N, 11
.set CYDEV_CHIP_MEMBER_4O, 8
.set CYDEV_CHIP_MEMBER_4P, 28
.set CYDEV_CHIP_MEMBER_4Q, 17
.set CYDEV_CHIP_MEMBER_4R, 9
.set CYDEV_CHIP_MEMBER_4S, 12
.set CYDEV_CHIP_MEMBER_4T, 10
.set CYDEV_CHIP_MEMBER_4U, 5
.set CYDEV_CHIP_MEMBER_4V, 23
.set CYDEV_CHIP_MEMBER_4W, 13
.set CYDEV_CHIP_MEMBER_4X, 7
.set CYDEV_CHIP_MEMBER_4Y, 18
.set CYDEV_CHIP_MEMBER_4Z, 19
.set CYDEV_CHIP_MEMBER_5A, 3
.set CYDEV_CHIP_MEMBER_5B, 2
.set CYDEV_CHIP_MEMBER_6A, 33
.set CYDEV_CHIP_MEMBER_FM3, 37
.set CYDEV_CHIP_MEMBER_FM4, 38
.set CYDEV_CHIP_MEMBER_PDL_FM0P_TYPE1, 34
.set CYDEV_CHIP_MEMBER_PDL_FM0P_TYPE2, 35
.set CYDEV_CHIP_MEMBER_PDL_FM0P_TYPE3, 36
.set CYDEV_CHIP_MEMBER_UNKNOWN, 0
.set CYDEV_CHIP_MEMBER_USED, CYDEV_CHIP_MEMBER_5B
.set CYDEV_CHIP_DIE_EXPECT, CYDEV_CHIP_MEMBER_USED
.set CYDEV_CHIP_DIE_ACTUAL, CYDEV_CHIP_DIE_EXPECT
.set CYDEV_CHIP_REV_LEOPARD_ES1, 0
.set CYDEV_CHIP_REV_LEOPARD_ES2, 1
.set CYDEV_CHIP_REV_LEOPARD_ES3, 3
.set CYDEV_CHIP_REV_LEOPARD_PRODUCTION, 3
.set CYDEV_CHIP_REV_PSOC4A_ES0, 17
.set CYDEV_CHIP_REV_PSOC4A_PRODUCTION, 17
.set CYDEV_CHIP_REV_PSOC5LP_ES0, 0
.set CYDEV_CHIP_REV_PSOC5LP_PRODUCTION, 0
.set CYDEV_CHIP_REV_PSOC5TM_ES0, 0
.set CYDEV_CHIP_REV_PSOC5TM_ES1, 1
.set CYDEV_CHIP_REV_PSOC5TM_PRODUCTION, 1
.set CYDEV_CHIP_REV_TMA4_ES, 17
.set CYDEV_CHIP_REV_TMA4_ES2, 33
.set CYDEV_CHIP_REV_TMA4_PRODUCTION, 17
.set CYDEV_CHIP_REVISION_3A_ES1, 0
.set CYDEV_CHIP_REVISION_3A_ES2, 1
.set CYDEV_CHIP_REVISION_3A_ES3, 3
.set CYDEV_CHIP_REVISION_3A_PRODUCTION, 3
.set CYDEV_CHIP_REVISION_4A_ES0, 17
.set CYDEV_CHIP_REVISION_4A_PRODUCTION, 17
.set CYDEV_CHIP_REVISION_4AA_PRODUCTION, 0
.set CYDEV_CHIP_REVISION_4AB_PRODUCTION, 0
.set CYDEV_CHIP_REVISION_4AC_PRODUCTION, 0
.set CYDEV_CHIP_REVISION_4AD_PRODUCTION, 0
.set CYDEV_CHIP_REVISION_4AE_PRODUCTION, 0
.set CYDEV_CHIP_REVISION_4D_PRODUCTION, 0
.set CYDEV_CHIP_REVISION_4E_CCG2_NO_USBPD, 0
.set CYDEV_CHIP_REVISION_4E_PRODUCTION, 0
.set CYDEV_CHIP_REVISION_4F_PRODUCTION, 0
.set CYDEV_CHIP_REVISION_4F_PRODUCTION_256DMA, 0
.set CYDEV_CHIP_REVISION_4F_PRODUCTION_256K, 0
.set CYDEV_CHIP_REVISION_4G_ES, 17
.set CYDEV_CHIP_REVISION_4G_ES2, 33
.set CYDEV_CHIP_REVISION_4G_PRODUCTION, 17
.set CYDEV_CHIP_REVISION_4H_PRODUCTION, 0
.set CYDEV_CHIP_REVISION_4I_PRODUCTION, 0
.set CYDEV_CHIP_REVISION_4J_PRODUCTION, 0
.set CYDEV_CHIP_REVISION_4K_PRODUCTION, 0
.set CYDEV_CHIP_REVISION_4L_PRODUCTION, 0
.set CYDEV_CHIP_REVISION_4M_PRODUCTION, 0
.set CYDEV_CHIP_REVISION_4N_PRODUCTION, 0
.set CYDEV_CHIP_REVISION_4O_PRODUCTION, 0
.set CYDEV_CHIP_REVISION_4P_PRODUCTION, 0
.set CYDEV_CHIP_REVISION_4Q_PRODUCTION, 0
.set CYDEV_CHIP_REVISION_4R_PRODUCTION, 0
.set CYDEV_CHIP_REVISION_4S_PRODUCTION, 0
.set CYDEV_CHIP_REVISION_4T_PRODUCTION, 0
.set CYDEV_CHIP_REVISION_4U_PRODUCTION, 0
.set CYDEV_CHIP_REVISION_4V_PRODUCTION, 0
.set CYDEV_CHIP_REVISION_4W_PRODUCTION, 0
.set CYDEV_CHIP_REVISION_4X_PRODUCTION, 0
.set CYDEV_CHIP_REVISION_4Y_PRODUCTION, 0
.set CYDEV_CHIP_REVISION_4Z_PRODUCTION, 0
.set CYDEV_CHIP_REVISION_5A_ES0, 0
.set CYDEV_CHIP_REVISION_5A_ES1, 1
.set CYDEV_CHIP_REVISION_5A_PRODUCTION, 1
.set CYDEV_CHIP_REVISION_5B_ES0, 0
.set CYDEV_CHIP_REVISION_5B_PRODUCTION, 0
.set CYDEV_CHIP_REVISION_6A_ES, 17
.set CYDEV_CHIP_REVISION_6A_NO_UDB, 33
.set CYDEV_CHIP_REVISION_6A_PRODUCTION, 33
.set CYDEV_CHIP_REVISION_FM3_PRODUCTION, 0
.set CYDEV_CHIP_REVISION_FM4_PRODUCTION, 0
.set CYDEV_CHIP_REVISION_PDL_FM0P_TYPE1_PRODUCTION, 0
.set CYDEV_CHIP_REVISION_PDL_FM0P_TYPE2_PRODUCTION, 0
.set CYDEV_CHIP_REVISION_PDL_FM0P_TYPE3_PRODUCTION, 0
.set CYDEV_CHIP_REVISION_USED, CYDEV_CHIP_REVISION_5B_PRODUCTION
.set CYDEV_CHIP_REV_EXPECT, CYDEV_CHIP_REVISION_USED
.set CYDEV_CONFIG_FASTBOOT_ENABLED, 1
.set CYDEV_CONFIG_UNUSED_IO_AllowButWarn, 0
.set CYDEV_CONFIG_UNUSED_IO, CYDEV_CONFIG_UNUSED_IO_AllowButWarn
.set CYDEV_CONFIG_UNUSED_IO_AllowWithInfo, 1
.set CYDEV_CONFIG_UNUSED_IO_Disallowed, 2
.set CYDEV_CONFIGURATION_COMPRESSED, 1
.set CYDEV_CONFIGURATION_DMA, 0
.set CYDEV_CONFIGURATION_ECC, 1
.set CYDEV_CONFIGURATION_IMOENABLED, CYDEV_CONFIG_FASTBOOT_ENABLED
.set CYDEV_CONFIGURATION_MODE_COMPRESSED, 0
.set CYDEV_CONFIGURATION_MODE, CYDEV_CONFIGURATION_MODE_COMPRESSED
.set CYDEV_CONFIGURATION_MODE_DMA, 2
.set CYDEV_CONFIGURATION_MODE_UNCOMPRESSED, 1
.set CYDEV_DEBUG_ENABLE_MASK, 0x20
.set CYDEV_DEBUG_ENABLE_REGISTER, CYREG_MLOGIC_DEBUG
.set CYDEV_DEBUGGING_DPS_Disable, 3
.set CYDEV_DEBUGGING_DPS_JTAG_4, 1
.set CYDEV_DEBUGGING_DPS_JTAG_5, 0
.set CYDEV_DEBUGGING_DPS_SWD, 2
.set CYDEV_DEBUGGING_DPS_SWD_SWV, 6
.set CYDEV_DEBUGGING_DPS, CYDEV_DEBUGGING_DPS_SWD_SWV
.set CYDEV_DEBUGGING_ENABLE, 1
.set CYDEV_DEBUGGING_XRES, 0
.set CYDEV_DMA_CHANNELS_AVAILABLE, 24
.set CYDEV_ECC_ENABLE, 0
.set CYDEV_HEAP_SIZE, 0x80
.set CYDEV_INSTRUCT_CACHE_ENABLED, 1
.set CYDEV_INTR_RISING, 0x00008001
.set CYDEV_IS_EXPORTING_CODE, 0
.set CYDEV_IS_IMPORTING_CODE, 0
.set CYDEV_PROJ_TYPE, 0
.set CYDEV_PROJ_TYPE_BOOTLOADER, 1
.set CYDEV_PROJ_TYPE_LAUNCHER, 5
.set CYDEV_PROJ_TYPE_LOADABLE, 2
.set CYDEV_PROJ_TYPE_LOADABLEANDBOOTLOADER, 4
.set CYDEV_PROJ_TYPE_MULTIAPPBOOTLOADER, 3
.set CYDEV_PROJ_TYPE_STANDARD, 0
.set CYDEV_PROTECTION_ENABLE, 0
.set CYDEV_STACK_SIZE, 0x0800
.set CYDEV_USE_BUNDLED_CMSIS, 1
.set CYDEV_VARIABLE_VDDA, 0
.set CYDEV_VDDA_MV, 5000
.set CYDEV_VDDD_MV, 5000
.set CYDEV_VDDIO0_MV, 5000
.set CYDEV_VDDIO1_MV, 5000
.set CYDEV_VDDIO2_MV, 5000
.set CYDEV_VDDIO3_MV, 5000
.set CYDEV_VIO0_MV, 5000
.set CYDEV_VIO1_MV, 5000
.set CYDEV_VIO2_MV, 5000
.set CYDEV_VIO3_MV, 5000
.set CYIPBLOCK_ARM_CM3_VERSION, 0
.set CYIPBLOCK_P3_ANAIF_VERSION, 0
.set CYIPBLOCK_P3_CAN_VERSION, 0
.set CYIPBLOCK_P3_CAPSENSE_VERSION, 0
.set CYIPBLOCK_P3_COMP_VERSION, 0
.set CYIPBLOCK_P3_DECIMATOR_VERSION, 0
.set CYIPBLOCK_P3_DFB_VERSION, 0
.set CYIPBLOCK_P3_DMA_VERSION, 0
.set CYIPBLOCK_P3_DRQ_VERSION, 0
.set CYIPBLOCK_P3_DSM_VERSION, 0
.set CYIPBLOCK_P3_EMIF_VERSION, 0
.set CYIPBLOCK_P3_I2C_VERSION, 0
.set CYIPBLOCK_P3_LCD_VERSION, 0
.set CYIPBLOCK_P3_LPF_VERSION, 0
.set CYIPBLOCK_P3_OPAMP_VERSION, 0
.set CYIPBLOCK_P3_PM_VERSION, 0
.set CYIPBLOCK_P3_SCCT_VERSION, 0
.set CYIPBLOCK_P3_TIMER_VERSION, 0
.set CYIPBLOCK_P3_USB_VERSION, 0
.set CYIPBLOCK_P3_VIDAC_VERSION, 0
.set CYIPBLOCK_P3_VREF_VERSION, 0
.set CYIPBLOCK_S8_GPIO_VERSION, 0
.set CYIPBLOCK_S8_IRQ_VERSION, 0
.set CYIPBLOCK_S8_SAR_VERSION, 0
.set CYIPBLOCK_S8_SIO_VERSION, 0
.set CYIPBLOCK_S8_UDB_VERSION, 0
.set DMA_CHANNELS_USED__MASK0, 0x00000000
.set CYDEV_BOOTLOADER_ENABLE, 0
.endif
